## CMakeLists.txt
```
# Copyright (c) 2024 inovex GmbH
# SPDX-License-Identifier: Apache-2.0

cmake_minimum_required(VERSION 3.20.0)

find_package(Zephyr REQUIRED HINTS $ENV{ZEPHYR_BASE})

project(peripheral)

target_sources(app PRIVATE
	src/main.c
	src/led_service.c
	src/uptime_service.c
)
target_include_directories(app PRIVATE
	"${CMAKE_CURRENT_LIST_DIR}/../include"
)
```

## prj.conf
```kconfig
CONFIG_EVENTS=y
CONFIG_LOG=y

CONFIG_GPIO=y

CONFIG_BT=y
CONFIG_BT_PERIPHERAL=y
CONFIG_BT_DEVICE_NAME="Example Peripheral"
```

## boards/nrf52833dk_nrf52833.overlay
```dts
/*
 * Copyright (c) 2024 inovex GmbH
 *
 * SPDX-License-Identifier: Apache-2.0
 */

/ {
	aliases {
		service-led = &led0;
	};
};
```

## src/main.c
```c
/*
 * Copyright (c) 2024 inovex GmbH
 *
 * SPDX-License-Identifier: Apache-2.0
 */

#include <zephyr/kernel.h>

#include <zephyr/drivers/gpio.h>

#include <zephyr/bluetooth/bluetooth.h>
#include <zephyr/bluetooth/hci.h>

#include <zephyr/logging/log.h>
LOG_MODULE_REGISTER(peripheral_main);

#include "demo/bluetooth/services/led_service.h"

enum app_event {
	APP_EVENT_CONNECTED = BIT(0),
	APP_EVENT_DISCONNECTED = BIT(1),
};
static K_EVENT_DEFINE(app_event);

#define SERVICE_LED_NODE DT_ALIAS(service_led)
static const struct gpio_dt_spec service_led = GPIO_DT_SPEC_GET(SERVICE_LED_NODE, gpios);

static void control_led(int enabled)
{
	int err = gpio_pin_set_dt(&service_led, enabled);
	if (err) {
		LOG_ERR("failed to set service led to %d: %d", enabled, err);
	}
}

static void on_connected(struct bt_conn *conn, uint8_t err)
{
	LOG_INF("device connected: %d", err);
	k_event_post(&app_event, APP_EVENT_CONNECTED);
}

static void on_disconnected(struct bt_conn *conn, uint8_t err)
{
	LOG_INF("device disconnected: %d", err);
	k_event_post(&app_event, APP_EVENT_DISCONNECTED);
}

static struct bt_conn_cb connection_callbacks = {
	.connected = on_connected,
	.disconnected = on_disconnected,
};

static struct bt_data advertisement_data[] = {
	BT_DATA_BYTES(BT_DATA_FLAGS, BT_LE_AD_LIMITED | BT_LE_AD_NO_BREDR),
	BT_DATA(BT_DATA_NAME_COMPLETE, CONFIG_BT_DEVICE_NAME, sizeof(CONFIG_BT_DEVICE_NAME) - 1),
};
static const struct bt_le_adv_param *advertisement_params = BT_LE_ADV_PARAM(
	BT_LE_ADV_OPT_CONNECTABLE, 32 /* 20 ms */, 48 /* 30 ms */, NULL /* undirected */);

static void print_ble_addrs(void)
{
	size_t count;
	char buf[BT_ADDR_LE_STR_LEN];
	bt_addr_le_t addrs[CONFIG_BT_ID_MAX];

	bt_id_get(&addrs[0], &count);
	if (count == 0) {
		LOG_INF("no BLE addresses available");
		return;
	}
	LOG_INF("BLE addresses:");
	for (size_t i = 0; i < count; i++) {
		bt_addr_le_to_str(&addrs[i], &buf[0], BT_ADDR_LE_STR_LEN);
		LOG_INF("\t%s", buf);
	}
}

static int start_advertising()
{
	LOG_INF("start advertising");
	int err = bt_le_adv_start(advertisement_params, advertisement_data,
				  ARRAY_SIZE(advertisement_data), NULL, 0);
	if (err) {
		LOG_ERR("failed to stop Bluetooth advertising: %d", err);
	}
	return err;
}

static int stop_advertising()
{
	LOG_INF("stop advertising");
	int err = bt_le_adv_stop();
	if (err) {
		LOG_ERR("failed to stop Bluetooth advertising: %d", err);
	}
	return err;
}

int main(void)
{
	if (!gpio_is_ready_dt(&service_led)) {
		LOG_ERR("service led not ready");
		return 1;
	}
	int err = gpio_pin_configure_dt(&service_led, GPIO_OUTPUT_INACTIVE);
	if (err) {
		LOG_ERR("failed to configure led: %d", err);
		return 1;
	}
	led_service_init(control_led);
	bt_conn_cb_register(&connection_callbacks);
	bt_enable(NULL);
	if (start_advertising()) {
		return 1;
	}
	print_ble_addrs();
	uint32_t events;
	for (;;) {
		events = k_event_wait(&app_event, APP_EVENT_CONNECTED | APP_EVENT_DISCONNECTED,
				      true, K_FOREVER);
		if (events & APP_EVENT_CONNECTED) {
			if (stop_advertising()) {
				return 1;
			}

		} else if (events & APP_EVENT_DISCONNECTED) {
			if (start_advertising()) {
				return 1;
			}
		}
	}
	return 0;
}
```

## src/led_service.c
```c
/*
 * Copyright (c) 2024 inovex GmbH
 *
 * SPDX-License-Identifier: Apache-2.0
 */

#include <zephyr/types.h>
#include <zephyr/kernel.h>

#include <zephyr/bluetooth/bluetooth.h>
#include <zephyr/bluetooth/gatt.h>

#include <zephyr/logging/log.h>
LOG_MODULE_REGISTER(led_service);

#include "demo/bluetooth/services/led_service.h"

static led_set_enabled_func set_enabled;
static int current_state;

static ssize_t read_led(struct bt_conn *conn, const struct bt_gatt_attr *attr, void *buf,
			uint16_t len, uint16_t offset)
{
	(void)conn;
	(void)attr;
	uint8_t state_byte = (uint8_t)current_state;
	LOG_INF("LED state read, returning 0x%02" PRIx8, state_byte);
	return bt_gatt_attr_read(conn, attr, buf, len, offset, &state_byte, sizeof(state_byte));
}

static ssize_t write_led(struct bt_conn *conn, const struct bt_gatt_attr *attr, const void *buf,
			 uint16_t len, uint16_t offset, uint8_t flags)
{
	(void)conn;
	(void)attr;
	if (len != 1u) {
		return BT_GATT_ERR(BT_ATT_ERR_INVALID_ATTRIBUTE_LEN);
	}
	if (offset != 0u) {
		return BT_GATT_ERR(BT_ATT_ERR_INVALID_OFFSET);
	}
	uint8_t new_state = ((const uint8_t *)buf)[0];
	if ((new_state != 0x00) && (new_state != 0x01)) {
		return BT_GATT_ERR(BT_ATT_ERR_VALUE_NOT_ALLOWED);
	}
	LOG_INF("LED state write 0x%02" PRIx8, new_state);
	if (new_state != current_state) {
		if (set_enabled) {
			set_enabled(new_state);
		}
		current_state = new_state;
	}
	return len;
}

BT_GATT_SERVICE_DEFINE(led_service, BT_GATT_PRIMARY_SERVICE(BT_UUID_LED_SERVICE),
		       BT_GATT_CHARACTERISTIC(BT_UUID_LED_CHARACTERISTIC,
					      BT_GATT_CHRC_READ | BT_GATT_CHRC_WRITE,
					      BT_GATT_PERM_READ | BT_GATT_PERM_WRITE, read_led,
					      write_led, NULL), );

void led_service_init(led_set_enabled_func cb)
{
	set_enabled = cb;
}
```

## src/uptime_service.c
```c
/*
 * Copyright (c) 2024 inovex GmbH
 *
 * SPDX-License-Identifier: Apache-2.0
 */

#include <zephyr/types.h>
#include <zephyr/kernel.h>

#include <zephyr/bluetooth/bluetooth.h>
#include <zephyr/bluetooth/gatt.h>

#include <zephyr/logging/log.h>
LOG_MODULE_REGISTER(uptime_service);

#include "demo/bluetooth/services/uptime_service.h"

static ssize_t read_uptime(struct bt_conn *conn, const struct bt_gatt_attr *attr, void *buf,
			   uint16_t len, uint16_t offset)
{
	(void)conn;
	(void)attr;
	int64_t uptime = k_uptime_get();
	LOG_INF("uptime read, returning %" PRIu64, uptime);
	return bt_gatt_attr_read(conn, attr, buf, len, offset, &uptime, sizeof(uptime));
}

BT_GATT_SERVICE_DEFINE(uptime_service, BT_GATT_PRIMARY_SERVICE(BT_UUID_UPTIME_SERVICE),
		       BT_GATT_CHARACTERISTIC(BT_UUID_UPTIME_CHARACTERISTIC, BT_GATT_CHRC_READ,
					      BT_GATT_PERM_READ, read_uptime, NULL, NULL), );
```
